    IF :LNOT::DEF:INCLUDED_CYFITTERRV_INC
INCLUDED_CYFITTERRV_INC EQU 1
    GET cydevicerv.inc
    GET cydevicerv_trm.inc

; ADC_DEC
ADC_DEC__COHER EQU CYREG_DEC_COHER
ADC_DEC__CR EQU CYREG_DEC_CR
ADC_DEC__DR1 EQU CYREG_DEC_DR1
ADC_DEC__DR2 EQU CYREG_DEC_DR2
ADC_DEC__DR2H EQU CYREG_DEC_DR2H
ADC_DEC__GCOR EQU CYREG_DEC_GCOR
ADC_DEC__GCORH EQU CYREG_DEC_GCORH
ADC_DEC__GVAL EQU CYREG_DEC_GVAL
ADC_DEC__OCOR EQU CYREG_DEC_OCOR
ADC_DEC__OCORH EQU CYREG_DEC_OCORH
ADC_DEC__OCORM EQU CYREG_DEC_OCORM
ADC_DEC__OUTSAMP EQU CYREG_DEC_OUTSAMP
ADC_DEC__OUTSAMPH EQU CYREG_DEC_OUTSAMPH
ADC_DEC__OUTSAMPM EQU CYREG_DEC_OUTSAMPM
ADC_DEC__OUTSAMPS EQU CYREG_DEC_OUTSAMPS
ADC_DEC__PM_ACT_CFG EQU CYREG_PM_ACT_CFG10
ADC_DEC__PM_ACT_MSK EQU 0x01
ADC_DEC__PM_STBY_CFG EQU CYREG_PM_STBY_CFG10
ADC_DEC__PM_STBY_MSK EQU 0x01
ADC_DEC__SHIFT1 EQU CYREG_DEC_SHIFT1
ADC_DEC__SHIFT2 EQU CYREG_DEC_SHIFT2
ADC_DEC__SR EQU CYREG_DEC_SR
ADC_DEC__TRIM__M1 EQU CYREG_FLSHID_CUST_TABLES_DEC_M1
ADC_DEC__TRIM__M2 EQU CYREG_FLSHID_CUST_TABLES_DEC_M2
ADC_DEC__TRIM__M3 EQU CYREG_FLSHID_CUST_TABLES_DEC_M3
ADC_DEC__TRIM__M4 EQU CYREG_FLSHID_CUST_TABLES_DEC_M4
ADC_DEC__TRIM__M5 EQU CYREG_FLSHID_CUST_TABLES_DEC_M5
ADC_DEC__TRIM__M6 EQU CYREG_FLSHID_CUST_TABLES_DEC_M6
ADC_DEC__TRIM__M7 EQU CYREG_FLSHID_CUST_TABLES_DEC_M7
ADC_DEC__TRIM__M8 EQU CYREG_FLSHID_CUST_TABLES_DEC_M8

; ADC_DSM
ADC_DSM__BUF0 EQU CYREG_DSM0_BUF0
ADC_DSM__BUF1 EQU CYREG_DSM0_BUF1
ADC_DSM__BUF2 EQU CYREG_DSM0_BUF2
ADC_DSM__BUF3 EQU CYREG_DSM0_BUF3
ADC_DSM__CLK EQU CYREG_DSM0_CLK
ADC_DSM__CR0 EQU CYREG_DSM0_CR0
ADC_DSM__CR1 EQU CYREG_DSM0_CR1
ADC_DSM__CR10 EQU CYREG_DSM0_CR10
ADC_DSM__CR11 EQU CYREG_DSM0_CR11
ADC_DSM__CR12 EQU CYREG_DSM0_CR12
ADC_DSM__CR13 EQU CYREG_DSM0_CR13
ADC_DSM__CR14 EQU CYREG_DSM0_CR14
ADC_DSM__CR15 EQU CYREG_DSM0_CR15
ADC_DSM__CR16 EQU CYREG_DSM0_CR16
ADC_DSM__CR17 EQU CYREG_DSM0_CR17
ADC_DSM__CR2 EQU CYREG_DSM0_CR2
ADC_DSM__CR3 EQU CYREG_DSM0_CR3
ADC_DSM__CR4 EQU CYREG_DSM0_CR4
ADC_DSM__CR5 EQU CYREG_DSM0_CR5
ADC_DSM__CR6 EQU CYREG_DSM0_CR6
ADC_DSM__CR7 EQU CYREG_DSM0_CR7
ADC_DSM__CR8 EQU CYREG_DSM0_CR8
ADC_DSM__CR9 EQU CYREG_DSM0_CR9
ADC_DSM__DEM0 EQU CYREG_DSM0_DEM0
ADC_DSM__DEM1 EQU CYREG_DSM0_DEM1
ADC_DSM__MISC EQU CYREG_DSM0_MISC
ADC_DSM__OUT0 EQU CYREG_DSM0_OUT0
ADC_DSM__OUT1 EQU CYREG_DSM0_OUT1
ADC_DSM__REF0 EQU CYREG_DSM0_REF0
ADC_DSM__REF1 EQU CYREG_DSM0_REF1
ADC_DSM__REF2 EQU CYREG_DSM0_REF2
ADC_DSM__REF3 EQU CYREG_DSM0_REF3
ADC_DSM__RSVD1 EQU CYREG_DSM0_RSVD1
ADC_DSM__SW0 EQU CYREG_DSM0_SW0
ADC_DSM__SW2 EQU CYREG_DSM0_SW2
ADC_DSM__SW3 EQU CYREG_DSM0_SW3
ADC_DSM__SW4 EQU CYREG_DSM0_SW4
ADC_DSM__SW6 EQU CYREG_DSM0_SW6
ADC_DSM__TR0 EQU CYREG_NPUMP_DSM_TR0
ADC_DSM__TST0 EQU CYREG_DSM0_TST0
ADC_DSM__TST1 EQU CYREG_DSM0_TST1

; ADC_Ext_CP_Clk
ADC_Ext_CP_Clk__CFG0 EQU CYREG_CLKDIST_DCFG0_CFG0
ADC_Ext_CP_Clk__CFG1 EQU CYREG_CLKDIST_DCFG0_CFG1
ADC_Ext_CP_Clk__CFG2 EQU CYREG_CLKDIST_DCFG0_CFG2
ADC_Ext_CP_Clk__CFG2_SRC_SEL_MASK EQU 0x07
ADC_Ext_CP_Clk__INDEX EQU 0x00
ADC_Ext_CP_Clk__PM_ACT_CFG EQU CYREG_PM_ACT_CFG2
ADC_Ext_CP_Clk__PM_ACT_MSK EQU 0x01
ADC_Ext_CP_Clk__PM_STBY_CFG EQU CYREG_PM_STBY_CFG2
ADC_Ext_CP_Clk__PM_STBY_MSK EQU 0x01

; ADC_IRQ
ADC_IRQ__INTC_CLR_EN_REG EQU CYREG_NVIC_CLRENA0
ADC_IRQ__INTC_CLR_PD_REG EQU CYREG_NVIC_CLRPEND0
ADC_IRQ__INTC_MASK EQU 0x20000000
ADC_IRQ__INTC_NUMBER EQU 29
ADC_IRQ__INTC_PRIOR_NUM EQU 7
ADC_IRQ__INTC_PRIOR_REG EQU CYREG_NVIC_PRI_29
ADC_IRQ__INTC_SET_EN_REG EQU CYREG_NVIC_SETENA0
ADC_IRQ__INTC_SET_PD_REG EQU CYREG_NVIC_SETPEND0

; ADC_theACLK
ADC_theACLK__CFG0 EQU CYREG_CLKDIST_ACFG0_CFG0
ADC_theACLK__CFG1 EQU CYREG_CLKDIST_ACFG0_CFG1
ADC_theACLK__CFG2 EQU CYREG_CLKDIST_ACFG0_CFG2
ADC_theACLK__CFG2_SRC_SEL_MASK EQU 0x07
ADC_theACLK__CFG3 EQU CYREG_CLKDIST_ACFG0_CFG3
ADC_theACLK__CFG3_PHASE_DLY_MASK EQU 0x0F
ADC_theACLK__INDEX EQU 0x00
ADC_theACLK__PM_ACT_CFG EQU CYREG_PM_ACT_CFG1
ADC_theACLK__PM_ACT_MSK EQU 0x01
ADC_theACLK__PM_STBY_CFG EQU CYREG_PM_STBY_CFG1
ADC_theACLK__PM_STBY_MSK EQU 0x01

; LCD_LCDPort
LCD_LCDPort__0__INTTYPE EQU CYREG_PICU2_INTTYPE0
LCD_LCDPort__0__MASK EQU 0x01
LCD_LCDPort__0__PC EQU CYREG_PRT2_PC0
LCD_LCDPort__0__PORT EQU 2
LCD_LCDPort__0__SHIFT EQU 0
LCD_LCDPort__1__INTTYPE EQU CYREG_PICU2_INTTYPE1
LCD_LCDPort__1__MASK EQU 0x02
LCD_LCDPort__1__PC EQU CYREG_PRT2_PC1
LCD_LCDPort__1__PORT EQU 2
LCD_LCDPort__1__SHIFT EQU 1
LCD_LCDPort__2__INTTYPE EQU CYREG_PICU2_INTTYPE2
LCD_LCDPort__2__MASK EQU 0x04
LCD_LCDPort__2__PC EQU CYREG_PRT2_PC2
LCD_LCDPort__2__PORT EQU 2
LCD_LCDPort__2__SHIFT EQU 2
LCD_LCDPort__3__INTTYPE EQU CYREG_PICU2_INTTYPE3
LCD_LCDPort__3__MASK EQU 0x08
LCD_LCDPort__3__PC EQU CYREG_PRT2_PC3
LCD_LCDPort__3__PORT EQU 2
LCD_LCDPort__3__SHIFT EQU 3
LCD_LCDPort__4__INTTYPE EQU CYREG_PICU2_INTTYPE4
LCD_LCDPort__4__MASK EQU 0x10
LCD_LCDPort__4__PC EQU CYREG_PRT2_PC4
LCD_LCDPort__4__PORT EQU 2
LCD_LCDPort__4__SHIFT EQU 4
LCD_LCDPort__5__INTTYPE EQU CYREG_PICU2_INTTYPE5
LCD_LCDPort__5__MASK EQU 0x20
LCD_LCDPort__5__PC EQU CYREG_PRT2_PC5
LCD_LCDPort__5__PORT EQU 2
LCD_LCDPort__5__SHIFT EQU 5
LCD_LCDPort__6__INTTYPE EQU CYREG_PICU2_INTTYPE6
LCD_LCDPort__6__MASK EQU 0x40
LCD_LCDPort__6__PC EQU CYREG_PRT2_PC6
LCD_LCDPort__6__PORT EQU 2
LCD_LCDPort__6__SHIFT EQU 6
LCD_LCDPort__AG EQU CYREG_PRT2_AG
LCD_LCDPort__AMUX EQU CYREG_PRT2_AMUX
LCD_LCDPort__BIE EQU CYREG_PRT2_BIE
LCD_LCDPort__BIT_MASK EQU CYREG_PRT2_BIT_MASK
LCD_LCDPort__BYP EQU CYREG_PRT2_BYP
LCD_LCDPort__CTL EQU CYREG_PRT2_CTL
LCD_LCDPort__DM0 EQU CYREG_PRT2_DM0
LCD_LCDPort__DM1 EQU CYREG_PRT2_DM1
LCD_LCDPort__DM2 EQU CYREG_PRT2_DM2
LCD_LCDPort__DR EQU CYREG_PRT2_DR
LCD_LCDPort__INP_DIS EQU CYREG_PRT2_INP_DIS
LCD_LCDPort__INTTYPE_BASE EQU CYDEV_PICU_INTTYPE_PICU2_BASE
LCD_LCDPort__LCD_COM_SEG EQU CYREG_PRT2_LCD_COM_SEG
LCD_LCDPort__LCD_EN EQU CYREG_PRT2_LCD_EN
LCD_LCDPort__MASK EQU 0x7F
LCD_LCDPort__PORT EQU 2
LCD_LCDPort__PRT EQU CYREG_PRT2_PRT
LCD_LCDPort__PRTDSI__CAPS_SEL EQU CYREG_PRT2_CAPS_SEL
LCD_LCDPort__PRTDSI__DBL_SYNC_IN EQU CYREG_PRT2_DBL_SYNC_IN
LCD_LCDPort__PRTDSI__OE_SEL0 EQU CYREG_PRT2_OE_SEL0
LCD_LCDPort__PRTDSI__OE_SEL1 EQU CYREG_PRT2_OE_SEL1
LCD_LCDPort__PRTDSI__OUT_SEL0 EQU CYREG_PRT2_OUT_SEL0
LCD_LCDPort__PRTDSI__OUT_SEL1 EQU CYREG_PRT2_OUT_SEL1
LCD_LCDPort__PRTDSI__SYNC_OUT EQU CYREG_PRT2_SYNC_OUT
LCD_LCDPort__PS EQU CYREG_PRT2_PS
LCD_LCDPort__SHIFT EQU 0
LCD_LCDPort__SLW EQU CYREG_PRT2_SLW

; Vhi
Vhi__0__INTTYPE EQU CYREG_PICU0_INTTYPE0
Vhi__0__MASK EQU 0x01
Vhi__0__PC EQU CYREG_PRT0_PC0
Vhi__0__PORT EQU 0
Vhi__0__SHIFT EQU 0
Vhi__AG EQU CYREG_PRT0_AG
Vhi__AMUX EQU CYREG_PRT0_AMUX
Vhi__BIE EQU CYREG_PRT0_BIE
Vhi__BIT_MASK EQU CYREG_PRT0_BIT_MASK
Vhi__BYP EQU CYREG_PRT0_BYP
Vhi__CTL EQU CYREG_PRT0_CTL
Vhi__DM0 EQU CYREG_PRT0_DM0
Vhi__DM1 EQU CYREG_PRT0_DM1
Vhi__DM2 EQU CYREG_PRT0_DM2
Vhi__DR EQU CYREG_PRT0_DR
Vhi__INP_DIS EQU CYREG_PRT0_INP_DIS
Vhi__INTTYPE_BASE EQU CYDEV_PICU_INTTYPE_PICU0_BASE
Vhi__LCD_COM_SEG EQU CYREG_PRT0_LCD_COM_SEG
Vhi__LCD_EN EQU CYREG_PRT0_LCD_EN
Vhi__MASK EQU 0x01
Vhi__PORT EQU 0
Vhi__PRT EQU CYREG_PRT0_PRT
Vhi__PRTDSI__CAPS_SEL EQU CYREG_PRT0_CAPS_SEL
Vhi__PRTDSI__DBL_SYNC_IN EQU CYREG_PRT0_DBL_SYNC_IN
Vhi__PRTDSI__OE_SEL0 EQU CYREG_PRT0_OE_SEL0
Vhi__PRTDSI__OE_SEL1 EQU CYREG_PRT0_OE_SEL1
Vhi__PRTDSI__OUT_SEL0 EQU CYREG_PRT0_OUT_SEL0
Vhi__PRTDSI__OUT_SEL1 EQU CYREG_PRT0_OUT_SEL1
Vhi__PRTDSI__SYNC_OUT EQU CYREG_PRT0_SYNC_OUT
Vhi__PS EQU CYREG_PRT0_PS
Vhi__SHIFT EQU 0
Vhi__SLW EQU CYREG_PRT0_SLW

; Vlow
Vlow__0__INTTYPE EQU CYREG_PICU0_INTTYPE2
Vlow__0__MASK EQU 0x04
Vlow__0__PC EQU CYREG_PRT0_PC2
Vlow__0__PORT EQU 0
Vlow__0__SHIFT EQU 2
Vlow__AG EQU CYREG_PRT0_AG
Vlow__AMUX EQU CYREG_PRT0_AMUX
Vlow__BIE EQU CYREG_PRT0_BIE
Vlow__BIT_MASK EQU CYREG_PRT0_BIT_MASK
Vlow__BYP EQU CYREG_PRT0_BYP
Vlow__CTL EQU CYREG_PRT0_CTL
Vlow__DM0 EQU CYREG_PRT0_DM0
Vlow__DM1 EQU CYREG_PRT0_DM1
Vlow__DM2 EQU CYREG_PRT0_DM2
Vlow__DR EQU CYREG_PRT0_DR
Vlow__INP_DIS EQU CYREG_PRT0_INP_DIS
Vlow__INTTYPE_BASE EQU CYDEV_PICU_INTTYPE_PICU0_BASE
Vlow__LCD_COM_SEG EQU CYREG_PRT0_LCD_COM_SEG
Vlow__LCD_EN EQU CYREG_PRT0_LCD_EN
Vlow__MASK EQU 0x04
Vlow__PORT EQU 0
Vlow__PRT EQU CYREG_PRT0_PRT
Vlow__PRTDSI__CAPS_SEL EQU CYREG_PRT0_CAPS_SEL
Vlow__PRTDSI__DBL_SYNC_IN EQU CYREG_PRT0_DBL_SYNC_IN
Vlow__PRTDSI__OE_SEL0 EQU CYREG_PRT0_OE_SEL0
Vlow__PRTDSI__OE_SEL1 EQU CYREG_PRT0_OE_SEL1
Vlow__PRTDSI__OUT_SEL0 EQU CYREG_PRT0_OUT_SEL0
Vlow__PRTDSI__OUT_SEL1 EQU CYREG_PRT0_OUT_SEL1
Vlow__PRTDSI__SYNC_OUT EQU CYREG_PRT0_SYNC_OUT
Vlow__PS EQU CYREG_PRT0_PS
Vlow__SHIFT EQU 2
Vlow__SLW EQU CYREG_PRT0_SLW

; Opamp_ABuf
Opamp_ABuf__CR EQU CYREG_OPAMP2_CR
Opamp_ABuf__MX EQU CYREG_OPAMP2_MX
Opamp_ABuf__NPUMP_OPAMP_TR0 EQU CYREG_NPUMP_OPAMP_TR0
Opamp_ABuf__PM_ACT_CFG EQU CYREG_PM_ACT_CFG4
Opamp_ABuf__PM_ACT_MSK EQU 0x04
Opamp_ABuf__PM_STBY_CFG EQU CYREG_PM_STBY_CFG4
Opamp_ABuf__PM_STBY_MSK EQU 0x04
Opamp_ABuf__RSVD EQU CYREG_OPAMP2_RSVD
Opamp_ABuf__SW EQU CYREG_OPAMP2_SW
Opamp_ABuf__TR0 EQU CYREG_OPAMP2_TR0
Opamp_ABuf__TR1 EQU CYREG_OPAMP2_TR1

; VDAC8_viDAC8
VDAC8_viDAC8__CR0 EQU CYREG_DAC0_CR0
VDAC8_viDAC8__CR1 EQU CYREG_DAC0_CR1
VDAC8_viDAC8__D EQU CYREG_DAC0_D
VDAC8_viDAC8__PM_ACT_CFG EQU CYREG_PM_ACT_CFG8
VDAC8_viDAC8__PM_ACT_MSK EQU 0x01
VDAC8_viDAC8__PM_STBY_CFG EQU CYREG_PM_STBY_CFG8
VDAC8_viDAC8__PM_STBY_MSK EQU 0x01
VDAC8_viDAC8__STROBE EQU CYREG_DAC0_STROBE
VDAC8_viDAC8__SW0 EQU CYREG_DAC0_SW0
VDAC8_viDAC8__SW2 EQU CYREG_DAC0_SW2
VDAC8_viDAC8__SW3 EQU CYREG_DAC0_SW3
VDAC8_viDAC8__SW4 EQU CYREG_DAC0_SW4
VDAC8_viDAC8__TR EQU CYREG_DAC0_TR
VDAC8_viDAC8__TRIM__M1 EQU CYREG_FLSHID_CUST_TABLES_DAC0_M1
VDAC8_viDAC8__TRIM__M2 EQU CYREG_FLSHID_CUST_TABLES_DAC0_M2
VDAC8_viDAC8__TRIM__M3 EQU CYREG_FLSHID_CUST_TABLES_DAC0_M3
VDAC8_viDAC8__TRIM__M4 EQU CYREG_FLSHID_CUST_TABLES_DAC0_M4
VDAC8_viDAC8__TRIM__M5 EQU CYREG_FLSHID_CUST_TABLES_DAC0_M5
VDAC8_viDAC8__TRIM__M6 EQU CYREG_FLSHID_CUST_TABLES_DAC0_M6
VDAC8_viDAC8__TRIM__M7 EQU CYREG_FLSHID_CUST_TABLES_DAC0_M7
VDAC8_viDAC8__TRIM__M8 EQU CYREG_FLSHID_CUST_TABLES_DAC0_M8
VDAC8_viDAC8__TST EQU CYREG_DAC0_TST

; CJTemp
CJTemp__0__INTTYPE EQU CYREG_PICU6_INTTYPE1
CJTemp__0__MASK EQU 0x02
CJTemp__0__PC EQU CYREG_PRT6_PC1
CJTemp__0__PORT EQU 6
CJTemp__0__SHIFT EQU 1
CJTemp__AG EQU CYREG_PRT6_AG
CJTemp__AMUX EQU CYREG_PRT6_AMUX
CJTemp__BIE EQU CYREG_PRT6_BIE
CJTemp__BIT_MASK EQU CYREG_PRT6_BIT_MASK
CJTemp__BYP EQU CYREG_PRT6_BYP
CJTemp__CTL EQU CYREG_PRT6_CTL
CJTemp__DM0 EQU CYREG_PRT6_DM0
CJTemp__DM1 EQU CYREG_PRT6_DM1
CJTemp__DM2 EQU CYREG_PRT6_DM2
CJTemp__DR EQU CYREG_PRT6_DR
CJTemp__INP_DIS EQU CYREG_PRT6_INP_DIS
CJTemp__INTTYPE_BASE EQU CYDEV_PICU_INTTYPE_PICU6_BASE
CJTemp__LCD_COM_SEG EQU CYREG_PRT6_LCD_COM_SEG
CJTemp__LCD_EN EQU CYREG_PRT6_LCD_EN
CJTemp__MASK EQU 0x02
CJTemp__PORT EQU 6
CJTemp__PRT EQU CYREG_PRT6_PRT
CJTemp__PRTDSI__CAPS_SEL EQU CYREG_PRT6_CAPS_SEL
CJTemp__PRTDSI__DBL_SYNC_IN EQU CYREG_PRT6_DBL_SYNC_IN
CJTemp__PRTDSI__OE_SEL0 EQU CYREG_PRT6_OE_SEL0
CJTemp__PRTDSI__OE_SEL1 EQU CYREG_PRT6_OE_SEL1
CJTemp__PRTDSI__OUT_SEL0 EQU CYREG_PRT6_OUT_SEL0
CJTemp__PRTDSI__OUT_SEL1 EQU CYREG_PRT6_OUT_SEL1
CJTemp__PRTDSI__SYNC_OUT EQU CYREG_PRT6_SYNC_OUT
CJTemp__PS EQU CYREG_PRT6_PS
CJTemp__SHIFT EQU 1
CJTemp__SLW EQU CYREG_PRT6_SLW

; Vtherm
Vtherm__0__INTTYPE EQU CYREG_PICU0_INTTYPE1
Vtherm__0__MASK EQU 0x02
Vtherm__0__PC EQU CYREG_PRT0_PC1
Vtherm__0__PORT EQU 0
Vtherm__0__SHIFT EQU 1
Vtherm__AG EQU CYREG_PRT0_AG
Vtherm__AMUX EQU CYREG_PRT0_AMUX
Vtherm__BIE EQU CYREG_PRT0_BIE
Vtherm__BIT_MASK EQU CYREG_PRT0_BIT_MASK
Vtherm__BYP EQU CYREG_PRT0_BYP
Vtherm__CTL EQU CYREG_PRT0_CTL
Vtherm__DM0 EQU CYREG_PRT0_DM0
Vtherm__DM1 EQU CYREG_PRT0_DM1
Vtherm__DM2 EQU CYREG_PRT0_DM2
Vtherm__DR EQU CYREG_PRT0_DR
Vtherm__INP_DIS EQU CYREG_PRT0_INP_DIS
Vtherm__INTTYPE_BASE EQU CYDEV_PICU_INTTYPE_PICU0_BASE
Vtherm__LCD_COM_SEG EQU CYREG_PRT0_LCD_COM_SEG
Vtherm__LCD_EN EQU CYREG_PRT0_LCD_EN
Vtherm__MASK EQU 0x02
Vtherm__PORT EQU 0
Vtherm__PRT EQU CYREG_PRT0_PRT
Vtherm__PRTDSI__CAPS_SEL EQU CYREG_PRT0_CAPS_SEL
Vtherm__PRTDSI__DBL_SYNC_IN EQU CYREG_PRT0_DBL_SYNC_IN
Vtherm__PRTDSI__OE_SEL0 EQU CYREG_PRT0_OE_SEL0
Vtherm__PRTDSI__OE_SEL1 EQU CYREG_PRT0_OE_SEL1
Vtherm__PRTDSI__OUT_SEL0 EQU CYREG_PRT0_OUT_SEL0
Vtherm__PRTDSI__OUT_SEL1 EQU CYREG_PRT0_OUT_SEL1
Vtherm__PRTDSI__SYNC_OUT EQU CYREG_PRT0_SYNC_OUT
Vtherm__PS EQU CYREG_PRT0_PS
Vtherm__SHIFT EQU 1
Vtherm__SLW EQU CYREG_PRT0_SLW

; Clock_1
Clock_1__CFG0 EQU CYREG_CLKDIST_DCFG2_CFG0
Clock_1__CFG1 EQU CYREG_CLKDIST_DCFG2_CFG1
Clock_1__CFG2 EQU CYREG_CLKDIST_DCFG2_CFG2
Clock_1__CFG2_SRC_SEL_MASK EQU 0x07
Clock_1__INDEX EQU 0x02
Clock_1__PM_ACT_CFG EQU CYREG_PM_ACT_CFG2
Clock_1__PM_ACT_MSK EQU 0x04
Clock_1__PM_STBY_CFG EQU CYREG_PM_STBY_CFG2
Clock_1__PM_STBY_MSK EQU 0x04

; CapSense_BufCH0
CapSense_BufCH0__CFG0 EQU CYREG_CAPSL_CFG0
CapSense_BufCH0__CFG1 EQU CYREG_CAPSL_CFG1
CapSense_BufCH0__PM_ACT_CFG EQU CYREG_PM_ACT_CFG11
CapSense_BufCH0__PM_ACT_MSK EQU 0x10
CapSense_BufCH0__PM_STBY_CFG EQU CYREG_PM_STBY_CFG11
CapSense_BufCH0__PM_STBY_MSK EQU 0x10

; CapSense_ClockGen
CapSense_ClockGen_sC16_PRSdp_u0__16BIT_A0_REG EQU CYREG_B0_UDB12_13_A0
CapSense_ClockGen_sC16_PRSdp_u0__16BIT_A1_REG EQU CYREG_B0_UDB12_13_A1
CapSense_ClockGen_sC16_PRSdp_u0__16BIT_D0_REG EQU CYREG_B0_UDB12_13_D0
CapSense_ClockGen_sC16_PRSdp_u0__16BIT_D1_REG EQU CYREG_B0_UDB12_13_D1
CapSense_ClockGen_sC16_PRSdp_u0__16BIT_DP_AUX_CTL_REG EQU CYREG_B0_UDB12_13_ACTL
CapSense_ClockGen_sC16_PRSdp_u0__16BIT_F0_REG EQU CYREG_B0_UDB12_13_F0
CapSense_ClockGen_sC16_PRSdp_u0__16BIT_F1_REG EQU CYREG_B0_UDB12_13_F1
CapSense_ClockGen_sC16_PRSdp_u0__A0_A1_REG EQU CYREG_B0_UDB12_A0_A1
CapSense_ClockGen_sC16_PRSdp_u0__A0_REG EQU CYREG_B0_UDB12_A0
CapSense_ClockGen_sC16_PRSdp_u0__A1_REG EQU CYREG_B0_UDB12_A1
CapSense_ClockGen_sC16_PRSdp_u0__D0_D1_REG EQU CYREG_B0_UDB12_D0_D1
CapSense_ClockGen_sC16_PRSdp_u0__D0_REG EQU CYREG_B0_UDB12_D0
CapSense_ClockGen_sC16_PRSdp_u0__D1_REG EQU CYREG_B0_UDB12_D1
CapSense_ClockGen_sC16_PRSdp_u0__DP_AUX_CTL_REG EQU CYREG_B0_UDB12_ACTL
CapSense_ClockGen_sC16_PRSdp_u0__F0_F1_REG EQU CYREG_B0_UDB12_F0_F1
CapSense_ClockGen_sC16_PRSdp_u0__F0_REG EQU CYREG_B0_UDB12_F0
CapSense_ClockGen_sC16_PRSdp_u0__F1_REG EQU CYREG_B0_UDB12_F1
CapSense_ClockGen_sC16_PRSdp_u1__16BIT_A0_REG EQU CYREG_B0_UDB13_14_A0
CapSense_ClockGen_sC16_PRSdp_u1__16BIT_A1_REG EQU CYREG_B0_UDB13_14_A1
CapSense_ClockGen_sC16_PRSdp_u1__16BIT_D0_REG EQU CYREG_B0_UDB13_14_D0
CapSense_ClockGen_sC16_PRSdp_u1__16BIT_D1_REG EQU CYREG_B0_UDB13_14_D1
CapSense_ClockGen_sC16_PRSdp_u1__16BIT_DP_AUX_CTL_REG EQU CYREG_B0_UDB13_14_ACTL
CapSense_ClockGen_sC16_PRSdp_u1__16BIT_F0_REG EQU CYREG_B0_UDB13_14_F0
CapSense_ClockGen_sC16_PRSdp_u1__16BIT_F1_REG EQU CYREG_B0_UDB13_14_F1
CapSense_ClockGen_sC16_PRSdp_u1__A0_A1_REG EQU CYREG_B0_UDB13_A0_A1
CapSense_ClockGen_sC16_PRSdp_u1__A0_REG EQU CYREG_B0_UDB13_A0
CapSense_ClockGen_sC16_PRSdp_u1__A1_REG EQU CYREG_B0_UDB13_A1
CapSense_ClockGen_sC16_PRSdp_u1__D0_D1_REG EQU CYREG_B0_UDB13_D0_D1
CapSense_ClockGen_sC16_PRSdp_u1__D0_REG EQU CYREG_B0_UDB13_D0
CapSense_ClockGen_sC16_PRSdp_u1__D1_REG EQU CYREG_B0_UDB13_D1
CapSense_ClockGen_sC16_PRSdp_u1__DP_AUX_CTL_REG EQU CYREG_B0_UDB13_ACTL
CapSense_ClockGen_sC16_PRSdp_u1__F0_F1_REG EQU CYREG_B0_UDB13_F0_F1
CapSense_ClockGen_sC16_PRSdp_u1__F0_REG EQU CYREG_B0_UDB13_F0
CapSense_ClockGen_sC16_PRSdp_u1__F1_REG EQU CYREG_B0_UDB13_F1
CapSense_ClockGen_sC16_PRSdp_u1__MSK_DP_AUX_CTL_REG EQU CYREG_B0_UDB13_MSK_ACTL
CapSense_ClockGen_sC16_PRSdp_u1__PER_DP_AUX_CTL_REG EQU CYREG_B0_UDB13_MSK_ACTL
CapSense_ClockGen_ScanSpeed__16BIT_CONTROL_AUX_CTL_REG EQU CYREG_B0_UDB11_12_ACTL
CapSense_ClockGen_ScanSpeed__16BIT_CONTROL_CONTROL_REG EQU CYREG_B0_UDB11_12_CTL
CapSense_ClockGen_ScanSpeed__16BIT_CONTROL_COUNT_REG EQU CYREG_B0_UDB11_12_CTL
CapSense_ClockGen_ScanSpeed__16BIT_COUNT_CONTROL_REG EQU CYREG_B0_UDB11_12_CTL
CapSense_ClockGen_ScanSpeed__16BIT_COUNT_COUNT_REG EQU CYREG_B0_UDB11_12_CTL
CapSense_ClockGen_ScanSpeed__16BIT_MASK_MASK_REG EQU CYREG_B0_UDB11_12_MSK
CapSense_ClockGen_ScanSpeed__16BIT_MASK_PERIOD_REG EQU CYREG_B0_UDB11_12_MSK
CapSense_ClockGen_ScanSpeed__16BIT_PERIOD_MASK_REG EQU CYREG_B0_UDB11_12_MSK
CapSense_ClockGen_ScanSpeed__16BIT_PERIOD_PERIOD_REG EQU CYREG_B0_UDB11_12_MSK
CapSense_ClockGen_ScanSpeed__CONTROL_AUX_CTL_REG EQU CYREG_B0_UDB11_ACTL
CapSense_ClockGen_ScanSpeed__CONTROL_REG EQU CYREG_B0_UDB11_CTL
CapSense_ClockGen_ScanSpeed__CONTROL_ST_REG EQU CYREG_B0_UDB11_ST_CTL
CapSense_ClockGen_ScanSpeed__COUNT_REG EQU CYREG_B0_UDB11_CTL
CapSense_ClockGen_ScanSpeed__COUNT_ST_REG EQU CYREG_B0_UDB11_ST_CTL
CapSense_ClockGen_ScanSpeed__MASK_CTL_AUX_CTL_REG EQU CYREG_B0_UDB11_MSK_ACTL
CapSense_ClockGen_ScanSpeed__PER_CTL_AUX_CTL_REG EQU CYREG_B0_UDB11_MSK_ACTL
CapSense_ClockGen_ScanSpeed__PERIOD_REG EQU CYREG_B0_UDB11_MSK
CapSense_ClockGen_SyncCtrl_CtrlReg__0__MASK EQU 0x01
CapSense_ClockGen_SyncCtrl_CtrlReg__0__POS EQU 0
CapSense_ClockGen_SyncCtrl_CtrlReg__1__MASK EQU 0x02
CapSense_ClockGen_SyncCtrl_CtrlReg__1__POS EQU 1
CapSense_ClockGen_SyncCtrl_CtrlReg__16BIT_CONTROL_AUX_CTL_REG EQU CYREG_B0_UDB13_14_ACTL
CapSense_ClockGen_SyncCtrl_CtrlReg__16BIT_CONTROL_CONTROL_REG EQU CYREG_B0_UDB13_14_CTL
CapSense_ClockGen_SyncCtrl_CtrlReg__16BIT_CONTROL_COUNT_REG EQU CYREG_B0_UDB13_14_CTL
CapSense_ClockGen_SyncCtrl_CtrlReg__16BIT_COUNT_CONTROL_REG EQU CYREG_B0_UDB13_14_CTL
CapSense_ClockGen_SyncCtrl_CtrlReg__16BIT_COUNT_COUNT_REG EQU CYREG_B0_UDB13_14_CTL
CapSense_ClockGen_SyncCtrl_CtrlReg__16BIT_MASK_MASK_REG EQU CYREG_B0_UDB13_14_MSK
CapSense_ClockGen_SyncCtrl_CtrlReg__16BIT_MASK_PERIOD_REG EQU CYREG_B0_UDB13_14_MSK
CapSense_ClockGen_SyncCtrl_CtrlReg__16BIT_PERIOD_MASK_REG EQU CYREG_B0_UDB13_14_MSK
CapSense_ClockGen_SyncCtrl_CtrlReg__16BIT_PERIOD_PERIOD_REG EQU CYREG_B0_UDB13_14_MSK
CapSense_ClockGen_SyncCtrl_CtrlReg__2__MASK EQU 0x04
CapSense_ClockGen_SyncCtrl_CtrlReg__2__POS EQU 2
CapSense_ClockGen_SyncCtrl_CtrlReg__4__MASK EQU 0x10
CapSense_ClockGen_SyncCtrl_CtrlReg__4__POS EQU 4
CapSense_ClockGen_SyncCtrl_CtrlReg__CONTROL_AUX_CTL_REG EQU CYREG_B0_UDB13_ACTL
CapSense_ClockGen_SyncCtrl_CtrlReg__CONTROL_REG EQU CYREG_B0_UDB13_CTL
CapSense_ClockGen_SyncCtrl_CtrlReg__CONTROL_ST_REG EQU CYREG_B0_UDB13_ST_CTL
CapSense_ClockGen_SyncCtrl_CtrlReg__COUNT_REG EQU CYREG_B0_UDB13_CTL
CapSense_ClockGen_SyncCtrl_CtrlReg__COUNT_ST_REG EQU CYREG_B0_UDB13_ST_CTL
CapSense_ClockGen_SyncCtrl_CtrlReg__MASK EQU 0x17
CapSense_ClockGen_SyncCtrl_CtrlReg__MASK_CTL_AUX_CTL_REG EQU CYREG_B0_UDB13_MSK_ACTL
CapSense_ClockGen_SyncCtrl_CtrlReg__PER_CTL_AUX_CTL_REG EQU CYREG_B0_UDB13_MSK_ACTL
CapSense_ClockGen_SyncCtrl_CtrlReg__PERIOD_REG EQU CYREG_B0_UDB13_MSK
CapSense_ClockGen_UDB_PrescalerDp_u0__16BIT_A0_REG EQU CYREG_B0_UDB14_15_A0
CapSense_ClockGen_UDB_PrescalerDp_u0__16BIT_A1_REG EQU CYREG_B0_UDB14_15_A1
CapSense_ClockGen_UDB_PrescalerDp_u0__16BIT_D0_REG EQU CYREG_B0_UDB14_15_D0
CapSense_ClockGen_UDB_PrescalerDp_u0__16BIT_D1_REG EQU CYREG_B0_UDB14_15_D1
CapSense_ClockGen_UDB_PrescalerDp_u0__16BIT_DP_AUX_CTL_REG EQU CYREG_B0_UDB14_15_ACTL
CapSense_ClockGen_UDB_PrescalerDp_u0__16BIT_F0_REG EQU CYREG_B0_UDB14_15_F0
CapSense_ClockGen_UDB_PrescalerDp_u0__16BIT_F1_REG EQU CYREG_B0_UDB14_15_F1
CapSense_ClockGen_UDB_PrescalerDp_u0__A0_A1_REG EQU CYREG_B0_UDB14_A0_A1
CapSense_ClockGen_UDB_PrescalerDp_u0__A0_REG EQU CYREG_B0_UDB14_A0
CapSense_ClockGen_UDB_PrescalerDp_u0__A1_REG EQU CYREG_B0_UDB14_A1
CapSense_ClockGen_UDB_PrescalerDp_u0__D0_D1_REG EQU CYREG_B0_UDB14_D0_D1
CapSense_ClockGen_UDB_PrescalerDp_u0__D0_REG EQU CYREG_B0_UDB14_D0
CapSense_ClockGen_UDB_PrescalerDp_u0__D1_REG EQU CYREG_B0_UDB14_D1
CapSense_ClockGen_UDB_PrescalerDp_u0__DP_AUX_CTL_REG EQU CYREG_B0_UDB14_ACTL
CapSense_ClockGen_UDB_PrescalerDp_u0__F0_F1_REG EQU CYREG_B0_UDB14_F0_F1
CapSense_ClockGen_UDB_PrescalerDp_u0__F0_REG EQU CYREG_B0_UDB14_F0
CapSense_ClockGen_UDB_PrescalerDp_u0__F1_REG EQU CYREG_B0_UDB14_F1

; CapSense_CmodCH0
CapSense_CmodCH0__0__INTTYPE EQU CYREG_PICU6_INTTYPE4
CapSense_CmodCH0__0__MASK EQU 0x10
CapSense_CmodCH0__0__PC EQU CYREG_PRT6_PC4
CapSense_CmodCH0__0__PORT EQU 6
CapSense_CmodCH0__0__SHIFT EQU 4
CapSense_CmodCH0__AG EQU CYREG_PRT6_AG
CapSense_CmodCH0__AMUX EQU CYREG_PRT6_AMUX
CapSense_CmodCH0__BIE EQU CYREG_PRT6_BIE
CapSense_CmodCH0__BIT_MASK EQU CYREG_PRT6_BIT_MASK
CapSense_CmodCH0__BYP EQU CYREG_PRT6_BYP
CapSense_CmodCH0__Cmod_CH0__INTTYPE EQU CYREG_PICU6_INTTYPE4
CapSense_CmodCH0__Cmod_CH0__MASK EQU 0x10
CapSense_CmodCH0__Cmod_CH0__PC EQU CYREG_PRT6_PC4
CapSense_CmodCH0__Cmod_CH0__PORT EQU 6
CapSense_CmodCH0__Cmod_CH0__SHIFT EQU 4
CapSense_CmodCH0__CTL EQU CYREG_PRT6_CTL
CapSense_CmodCH0__DM0 EQU CYREG_PRT6_DM0
CapSense_CmodCH0__DM1 EQU CYREG_PRT6_DM1
CapSense_CmodCH0__DM2 EQU CYREG_PRT6_DM2
CapSense_CmodCH0__DR EQU CYREG_PRT6_DR
CapSense_CmodCH0__INP_DIS EQU CYREG_PRT6_INP_DIS
CapSense_CmodCH0__INTTYPE_BASE EQU CYDEV_PICU_INTTYPE_PICU6_BASE
CapSense_CmodCH0__LCD_COM_SEG EQU CYREG_PRT6_LCD_COM_SEG
CapSense_CmodCH0__LCD_EN EQU CYREG_PRT6_LCD_EN
CapSense_CmodCH0__MASK EQU 0x10
CapSense_CmodCH0__PORT EQU 6
CapSense_CmodCH0__PRT EQU CYREG_PRT6_PRT
CapSense_CmodCH0__PRTDSI__CAPS_SEL EQU CYREG_PRT6_CAPS_SEL
CapSense_CmodCH0__PRTDSI__DBL_SYNC_IN EQU CYREG_PRT6_DBL_SYNC_IN
CapSense_CmodCH0__PRTDSI__OE_SEL0 EQU CYREG_PRT6_OE_SEL0
CapSense_CmodCH0__PRTDSI__OE_SEL1 EQU CYREG_PRT6_OE_SEL1
CapSense_CmodCH0__PRTDSI__OUT_SEL0 EQU CYREG_PRT6_OUT_SEL0
CapSense_CmodCH0__PRTDSI__OUT_SEL1 EQU CYREG_PRT6_OUT_SEL1
CapSense_CmodCH0__PRTDSI__SYNC_OUT EQU CYREG_PRT6_SYNC_OUT
CapSense_CmodCH0__PS EQU CYREG_PRT6_PS
CapSense_CmodCH0__SHIFT EQU 4
CapSense_CmodCH0__SLW EQU CYREG_PRT6_SLW

; CapSense_CompCH0_ctComp
CapSense_CompCH0_ctComp__CLK EQU CYREG_CMP0_CLK
CapSense_CompCH0_ctComp__CMP_MASK EQU 0x01
CapSense_CompCH0_ctComp__CMP_NUMBER EQU 0
CapSense_CompCH0_ctComp__CR EQU CYREG_CMP0_CR
CapSense_CompCH0_ctComp__LUT__CR EQU CYREG_LUT0_CR
CapSense_CompCH0_ctComp__LUT__MSK EQU CYREG_LUT_MSK
CapSense_CompCH0_ctComp__LUT__MSK_MASK EQU 0x01
CapSense_CompCH0_ctComp__LUT__MSK_SHIFT EQU 0
CapSense_CompCH0_ctComp__LUT__MX EQU CYREG_LUT0_MX
CapSense_CompCH0_ctComp__LUT__SR EQU CYREG_LUT_SR
CapSense_CompCH0_ctComp__LUT__SR_MASK EQU 0x01
CapSense_CompCH0_ctComp__LUT__SR_SHIFT EQU 0
CapSense_CompCH0_ctComp__PM_ACT_CFG EQU CYREG_PM_ACT_CFG7
CapSense_CompCH0_ctComp__PM_ACT_MSK EQU 0x01
CapSense_CompCH0_ctComp__PM_STBY_CFG EQU CYREG_PM_STBY_CFG7
CapSense_CompCH0_ctComp__PM_STBY_MSK EQU 0x01
CapSense_CompCH0_ctComp__SW0 EQU CYREG_CMP0_SW0
CapSense_CompCH0_ctComp__SW2 EQU CYREG_CMP0_SW2
CapSense_CompCH0_ctComp__SW3 EQU CYREG_CMP0_SW3
CapSense_CompCH0_ctComp__SW4 EQU CYREG_CMP0_SW4
CapSense_CompCH0_ctComp__SW6 EQU CYREG_CMP0_SW6
CapSense_CompCH0_ctComp__TR0 EQU CYREG_CMP0_TR0
CapSense_CompCH0_ctComp__TR1 EQU CYREG_CMP0_TR1
CapSense_CompCH0_ctComp__TRIM__TR0 EQU CYREG_FLSHID_MFG_CFG_CMP0_TR0
CapSense_CompCH0_ctComp__TRIM__TR0_HS EQU CYREG_FLSHID_CUST_TABLES_CMP0_TR0_HS
CapSense_CompCH0_ctComp__TRIM__TR1 EQU CYREG_FLSHID_MFG_CFG_CMP0_TR1
CapSense_CompCH0_ctComp__TRIM__TR1_HS EQU CYREG_FLSHID_CUST_TABLES_CMP0_TR1_HS
CapSense_CompCH0_ctComp__WRK EQU CYREG_CMP_WRK
CapSense_CompCH0_ctComp__WRK_MASK EQU 0x01
CapSense_CompCH0_ctComp__WRK_SHIFT EQU 0

; CapSense_IdacCH0_viDAC8
CapSense_IdacCH0_viDAC8__CR0 EQU CYREG_DAC3_CR0
CapSense_IdacCH0_viDAC8__CR1 EQU CYREG_DAC3_CR1
CapSense_IdacCH0_viDAC8__D EQU CYREG_DAC3_D
CapSense_IdacCH0_viDAC8__PM_ACT_CFG EQU CYREG_PM_ACT_CFG8
CapSense_IdacCH0_viDAC8__PM_ACT_MSK EQU 0x08
CapSense_IdacCH0_viDAC8__PM_STBY_CFG EQU CYREG_PM_STBY_CFG8
CapSense_IdacCH0_viDAC8__PM_STBY_MSK EQU 0x08
CapSense_IdacCH0_viDAC8__STROBE EQU CYREG_DAC3_STROBE
CapSense_IdacCH0_viDAC8__SW0 EQU CYREG_DAC3_SW0
CapSense_IdacCH0_viDAC8__SW2 EQU CYREG_DAC3_SW2
CapSense_IdacCH0_viDAC8__SW3 EQU CYREG_DAC3_SW3
CapSense_IdacCH0_viDAC8__SW4 EQU CYREG_DAC3_SW4
CapSense_IdacCH0_viDAC8__TR EQU CYREG_DAC3_TR
CapSense_IdacCH0_viDAC8__TRIM__M1 EQU CYREG_FLSHID_CUST_TABLES_DAC3_M1
CapSense_IdacCH0_viDAC8__TRIM__M2 EQU CYREG_FLSHID_CUST_TABLES_DAC3_M2
CapSense_IdacCH0_viDAC8__TRIM__M3 EQU CYREG_FLSHID_CUST_TABLES_DAC3_M3
CapSense_IdacCH0_viDAC8__TRIM__M4 EQU CYREG_FLSHID_CUST_TABLES_DAC3_M4
CapSense_IdacCH0_viDAC8__TRIM__M5 EQU CYREG_FLSHID_CUST_TABLES_DAC3_M5
CapSense_IdacCH0_viDAC8__TRIM__M6 EQU CYREG_FLSHID_CUST_TABLES_DAC3_M6
CapSense_IdacCH0_viDAC8__TRIM__M7 EQU CYREG_FLSHID_CUST_TABLES_DAC3_M7
CapSense_IdacCH0_viDAC8__TRIM__M8 EQU CYREG_FLSHID_CUST_TABLES_DAC3_M8
CapSense_IdacCH0_viDAC8__TST EQU CYREG_DAC3_TST

; CapSense_IntClock
CapSense_IntClock__CFG0 EQU CYREG_CLKDIST_DCFG1_CFG0
CapSense_IntClock__CFG1 EQU CYREG_CLKDIST_DCFG1_CFG1
CapSense_IntClock__CFG2 EQU CYREG_CLKDIST_DCFG1_CFG2
CapSense_IntClock__CFG2_SRC_SEL_MASK EQU 0x07
CapSense_IntClock__INDEX EQU 0x01
CapSense_IntClock__PM_ACT_CFG EQU CYREG_PM_ACT_CFG2
CapSense_IntClock__PM_ACT_MSK EQU 0x02
CapSense_IntClock__PM_STBY_CFG EQU CYREG_PM_STBY_CFG2
CapSense_IntClock__PM_STBY_MSK EQU 0x02

; CapSense_IsrCH0
CapSense_IsrCH0__INTC_CLR_EN_REG EQU CYREG_NVIC_CLRENA0
CapSense_IsrCH0__INTC_CLR_PD_REG EQU CYREG_NVIC_CLRPEND0
CapSense_IsrCH0__INTC_MASK EQU 0x01
CapSense_IsrCH0__INTC_NUMBER EQU 0
CapSense_IsrCH0__INTC_PRIOR_NUM EQU 7
CapSense_IsrCH0__INTC_PRIOR_REG EQU CYREG_NVIC_PRI_0
CapSense_IsrCH0__INTC_SET_EN_REG EQU CYREG_NVIC_SETENA0
CapSense_IsrCH0__INTC_SET_PD_REG EQU CYREG_NVIC_SETPEND0

; CapSense_MeasureCH0
CapSense_MeasureCH0_UDB_Counter_u0__A0_A1_REG EQU CYREG_B0_UDB15_A0_A1
CapSense_MeasureCH0_UDB_Counter_u0__A0_REG EQU CYREG_B0_UDB15_A0
CapSense_MeasureCH0_UDB_Counter_u0__A1_REG EQU CYREG_B0_UDB15_A1
CapSense_MeasureCH0_UDB_Counter_u0__D0_D1_REG EQU CYREG_B0_UDB15_D0_D1
CapSense_MeasureCH0_UDB_Counter_u0__D0_REG EQU CYREG_B0_UDB15_D0
CapSense_MeasureCH0_UDB_Counter_u0__D1_REG EQU CYREG_B0_UDB15_D1
CapSense_MeasureCH0_UDB_Counter_u0__DP_AUX_CTL_REG EQU CYREG_B0_UDB15_ACTL
CapSense_MeasureCH0_UDB_Counter_u0__F0_F1_REG EQU CYREG_B0_UDB15_F0_F1
CapSense_MeasureCH0_UDB_Counter_u0__F0_REG EQU CYREG_B0_UDB15_F0
CapSense_MeasureCH0_UDB_Counter_u0__F1_REG EQU CYREG_B0_UDB15_F1
CapSense_MeasureCH0_UDB_Window_u0__16BIT_A0_REG EQU CYREG_B0_UDB10_11_A0
CapSense_MeasureCH0_UDB_Window_u0__16BIT_A1_REG EQU CYREG_B0_UDB10_11_A1
CapSense_MeasureCH0_UDB_Window_u0__16BIT_D0_REG EQU CYREG_B0_UDB10_11_D0
CapSense_MeasureCH0_UDB_Window_u0__16BIT_D1_REG EQU CYREG_B0_UDB10_11_D1
CapSense_MeasureCH0_UDB_Window_u0__16BIT_DP_AUX_CTL_REG EQU CYREG_B0_UDB10_11_ACTL
CapSense_MeasureCH0_UDB_Window_u0__16BIT_F0_REG EQU CYREG_B0_UDB10_11_F0
CapSense_MeasureCH0_UDB_Window_u0__16BIT_F1_REG EQU CYREG_B0_UDB10_11_F1
CapSense_MeasureCH0_UDB_Window_u0__A0_A1_REG EQU CYREG_B0_UDB10_A0_A1
CapSense_MeasureCH0_UDB_Window_u0__A0_REG EQU CYREG_B0_UDB10_A0
CapSense_MeasureCH0_UDB_Window_u0__A1_REG EQU CYREG_B0_UDB10_A1
CapSense_MeasureCH0_UDB_Window_u0__D0_D1_REG EQU CYREG_B0_UDB10_D0_D1
CapSense_MeasureCH0_UDB_Window_u0__D0_REG EQU CYREG_B0_UDB10_D0
CapSense_MeasureCH0_UDB_Window_u0__D1_REG EQU CYREG_B0_UDB10_D1
CapSense_MeasureCH0_UDB_Window_u0__DP_AUX_CTL_REG EQU CYREG_B0_UDB10_ACTL
CapSense_MeasureCH0_UDB_Window_u0__F0_F1_REG EQU CYREG_B0_UDB10_F0_F1
CapSense_MeasureCH0_UDB_Window_u0__F0_REG EQU CYREG_B0_UDB10_F0
CapSense_MeasureCH0_UDB_Window_u0__F1_REG EQU CYREG_B0_UDB10_F1

; CapSense_PortCH0
CapSense_PortCH0__0__INTTYPE EQU CYREG_PICU5_INTTYPE5
CapSense_PortCH0__0__MASK EQU 0x20
CapSense_PortCH0__0__PC EQU CYREG_PRT5_PC5
CapSense_PortCH0__0__PORT EQU 5
CapSense_PortCH0__0__SHIFT EQU 5
CapSense_PortCH0__1__INTTYPE EQU CYREG_PICU5_INTTYPE6
CapSense_PortCH0__1__MASK EQU 0x40
CapSense_PortCH0__1__PC EQU CYREG_PRT5_PC6
CapSense_PortCH0__1__PORT EQU 5
CapSense_PortCH0__1__SHIFT EQU 6
CapSense_PortCH0__2__INTTYPE EQU CYREG_PICU5_INTTYPE0
CapSense_PortCH0__2__MASK EQU 0x01
CapSense_PortCH0__2__PC EQU CYREG_PRT5_PC0
CapSense_PortCH0__2__PORT EQU 5
CapSense_PortCH0__2__SHIFT EQU 0
CapSense_PortCH0__3__INTTYPE EQU CYREG_PICU5_INTTYPE1
CapSense_PortCH0__3__MASK EQU 0x02
CapSense_PortCH0__3__PC EQU CYREG_PRT5_PC1
CapSense_PortCH0__3__PORT EQU 5
CapSense_PortCH0__3__SHIFT EQU 1
CapSense_PortCH0__4__INTTYPE EQU CYREG_PICU5_INTTYPE2
CapSense_PortCH0__4__MASK EQU 0x04
CapSense_PortCH0__4__PC EQU CYREG_PRT5_PC2
CapSense_PortCH0__4__PORT EQU 5
CapSense_PortCH0__4__SHIFT EQU 2
CapSense_PortCH0__5__INTTYPE EQU CYREG_PICU5_INTTYPE3
CapSense_PortCH0__5__MASK EQU 0x08
CapSense_PortCH0__5__PC EQU CYREG_PRT5_PC3
CapSense_PortCH0__5__PORT EQU 5
CapSense_PortCH0__5__SHIFT EQU 3
CapSense_PortCH0__6__INTTYPE EQU CYREG_PICU5_INTTYPE4
CapSense_PortCH0__6__MASK EQU 0x10
CapSense_PortCH0__6__PC EQU CYREG_PRT5_PC4
CapSense_PortCH0__6__PORT EQU 5
CapSense_PortCH0__6__SHIFT EQU 4
CapSense_PortCH0__AG EQU CYREG_PRT5_AG
CapSense_PortCH0__AMUX EQU CYREG_PRT5_AMUX
CapSense_PortCH0__BIE EQU CYREG_PRT5_BIE
CapSense_PortCH0__BIT_MASK EQU CYREG_PRT5_BIT_MASK
CapSense_PortCH0__Button0__BTN__INTTYPE EQU CYREG_PICU5_INTTYPE5
CapSense_PortCH0__Button0__BTN__MASK EQU 0x20
CapSense_PortCH0__Button0__BTN__PC EQU CYREG_PRT5_PC5
CapSense_PortCH0__Button0__BTN__PORT EQU 5
CapSense_PortCH0__Button0__BTN__SHIFT EQU 5
CapSense_PortCH0__Button1__BTN__INTTYPE EQU CYREG_PICU5_INTTYPE6
CapSense_PortCH0__Button1__BTN__MASK EQU 0x40
CapSense_PortCH0__Button1__BTN__PC EQU CYREG_PRT5_PC6
CapSense_PortCH0__Button1__BTN__PORT EQU 5
CapSense_PortCH0__Button1__BTN__SHIFT EQU 6
CapSense_PortCH0__BYP EQU CYREG_PRT5_BYP
CapSense_PortCH0__CTL EQU CYREG_PRT5_CTL
CapSense_PortCH0__DM0 EQU CYREG_PRT5_DM0
CapSense_PortCH0__DM1 EQU CYREG_PRT5_DM1
CapSense_PortCH0__DM2 EQU CYREG_PRT5_DM2
CapSense_PortCH0__DR EQU CYREG_PRT5_DR
CapSense_PortCH0__INP_DIS EQU CYREG_PRT5_INP_DIS
CapSense_PortCH0__INTTYPE_BASE EQU CYDEV_PICU_INTTYPE_PICU5_BASE
CapSense_PortCH0__LCD_COM_SEG EQU CYREG_PRT5_LCD_COM_SEG
CapSense_PortCH0__LCD_EN EQU CYREG_PRT5_LCD_EN
CapSense_PortCH0__LinearSlider0_e0__LS__INTTYPE EQU CYREG_PICU5_INTTYPE0
CapSense_PortCH0__LinearSlider0_e0__LS__MASK EQU 0x01
CapSense_PortCH0__LinearSlider0_e0__LS__PC EQU CYREG_PRT5_PC0
CapSense_PortCH0__LinearSlider0_e0__LS__PORT EQU 5
CapSense_PortCH0__LinearSlider0_e0__LS__SHIFT EQU 0
CapSense_PortCH0__LinearSlider0_e1__LS__INTTYPE EQU CYREG_PICU5_INTTYPE1
CapSense_PortCH0__LinearSlider0_e1__LS__MASK EQU 0x02
CapSense_PortCH0__LinearSlider0_e1__LS__PC EQU CYREG_PRT5_PC1
CapSense_PortCH0__LinearSlider0_e1__LS__PORT EQU 5
CapSense_PortCH0__LinearSlider0_e1__LS__SHIFT EQU 1
CapSense_PortCH0__LinearSlider0_e2__LS__INTTYPE EQU CYREG_PICU5_INTTYPE2
CapSense_PortCH0__LinearSlider0_e2__LS__MASK EQU 0x04
CapSense_PortCH0__LinearSlider0_e2__LS__PC EQU CYREG_PRT5_PC2
CapSense_PortCH0__LinearSlider0_e2__LS__PORT EQU 5
CapSense_PortCH0__LinearSlider0_e2__LS__SHIFT EQU 2
CapSense_PortCH0__LinearSlider0_e3__LS__INTTYPE EQU CYREG_PICU5_INTTYPE3
CapSense_PortCH0__LinearSlider0_e3__LS__MASK EQU 0x08
CapSense_PortCH0__LinearSlider0_e3__LS__PC EQU CYREG_PRT5_PC3
CapSense_PortCH0__LinearSlider0_e3__LS__PORT EQU 5
CapSense_PortCH0__LinearSlider0_e3__LS__SHIFT EQU 3
CapSense_PortCH0__LinearSlider0_e4__LS__INTTYPE EQU CYREG_PICU5_INTTYPE4
CapSense_PortCH0__LinearSlider0_e4__LS__MASK EQU 0x10
CapSense_PortCH0__LinearSlider0_e4__LS__PC EQU CYREG_PRT5_PC4
CapSense_PortCH0__LinearSlider0_e4__LS__PORT EQU 5
CapSense_PortCH0__LinearSlider0_e4__LS__SHIFT EQU 4
CapSense_PortCH0__PORT EQU 5
CapSense_PortCH0__PRT EQU CYREG_PRT5_PRT
CapSense_PortCH0__PRTDSI__CAPS_SEL EQU CYREG_PRT5_CAPS_SEL
CapSense_PortCH0__PRTDSI__DBL_SYNC_IN EQU CYREG_PRT5_DBL_SYNC_IN
CapSense_PortCH0__PRTDSI__OE_SEL0 EQU CYREG_PRT5_OE_SEL0
CapSense_PortCH0__PRTDSI__OE_SEL1 EQU CYREG_PRT5_OE_SEL1
CapSense_PortCH0__PRTDSI__OUT_SEL0 EQU CYREG_PRT5_OUT_SEL0
CapSense_PortCH0__PRTDSI__OUT_SEL1 EQU CYREG_PRT5_OUT_SEL1
CapSense_PortCH0__PRTDSI__SYNC_OUT EQU CYREG_PRT5_SYNC_OUT
CapSense_PortCH0__PS EQU CYREG_PRT5_PS
CapSense_PortCH0__SLW EQU CYREG_PRT5_SLW

; isr_Calibration
isr_Calibration__INTC_CLR_EN_REG EQU CYREG_NVIC_CLRENA0
isr_Calibration__INTC_CLR_PD_REG EQU CYREG_NVIC_CLRPEND0
isr_Calibration__INTC_MASK EQU 0x02
isr_Calibration__INTC_NUMBER EQU 1
isr_Calibration__INTC_PRIOR_NUM EQU 7
isr_Calibration__INTC_PRIOR_REG EQU CYREG_NVIC_PRI_1
isr_Calibration__INTC_SET_EN_REG EQU CYREG_NVIC_SETENA0
isr_Calibration__INTC_SET_PD_REG EQU CYREG_NVIC_SETPEND0

; Miscellaneous
BCLK__BUS_CLK__HZ EQU 24000000
BCLK__BUS_CLK__KHZ EQU 24000
BCLK__BUS_CLK__MHZ EQU 24
CYDEV_CHIP_DIE_LEOPARD EQU 1
CYDEV_CHIP_DIE_PANTHER EQU 18
CYDEV_CHIP_DIE_PSOC4A EQU 10
CYDEV_CHIP_DIE_PSOC5LP EQU 17
CYDEV_CHIP_DIE_TMA4 EQU 2
CYDEV_CHIP_DIE_UNKNOWN EQU 0
CYDEV_CHIP_FAMILY_PSOC3 EQU 1
CYDEV_CHIP_FAMILY_PSOC4 EQU 2
CYDEV_CHIP_FAMILY_PSOC5 EQU 3
CYDEV_CHIP_FAMILY_UNKNOWN EQU 0
CYDEV_CHIP_FAMILY_USED EQU CYDEV_CHIP_FAMILY_PSOC5
CYDEV_CHIP_JTAG_ID EQU 0x2E123069
CYDEV_CHIP_MEMBER_3A EQU 1
CYDEV_CHIP_MEMBER_4A EQU 10
CYDEV_CHIP_MEMBER_4C EQU 15
CYDEV_CHIP_MEMBER_4D EQU 6
CYDEV_CHIP_MEMBER_4E EQU 4
CYDEV_CHIP_MEMBER_4F EQU 11
CYDEV_CHIP_MEMBER_4G EQU 2
CYDEV_CHIP_MEMBER_4H EQU 9
CYDEV_CHIP_MEMBER_4I EQU 14
CYDEV_CHIP_MEMBER_4J EQU 7
CYDEV_CHIP_MEMBER_4K EQU 8
CYDEV_CHIP_MEMBER_4L EQU 13
CYDEV_CHIP_MEMBER_4M EQU 12
CYDEV_CHIP_MEMBER_4N EQU 5
CYDEV_CHIP_MEMBER_4U EQU 3
CYDEV_CHIP_MEMBER_5A EQU 17
CYDEV_CHIP_MEMBER_5B EQU 16
CYDEV_CHIP_MEMBER_UNKNOWN EQU 0
CYDEV_CHIP_MEMBER_USED EQU CYDEV_CHIP_MEMBER_5B
CYDEV_CHIP_DIE_EXPECT EQU CYDEV_CHIP_MEMBER_USED
CYDEV_CHIP_DIE_ACTUAL EQU CYDEV_CHIP_DIE_EXPECT
CYDEV_CHIP_REV_LEOPARD_ES1 EQU 0
CYDEV_CHIP_REV_LEOPARD_ES2 EQU 1
CYDEV_CHIP_REV_LEOPARD_ES3 EQU 3
CYDEV_CHIP_REV_LEOPARD_PRODUCTION EQU 3
CYDEV_CHIP_REV_PANTHER_ES0 EQU 0
CYDEV_CHIP_REV_PANTHER_ES1 EQU 1
CYDEV_CHIP_REV_PANTHER_PRODUCTION EQU 1
CYDEV_CHIP_REV_PSOC4A_ES0 EQU 17
CYDEV_CHIP_REV_PSOC4A_PRODUCTION EQU 17
CYDEV_CHIP_REV_PSOC5LP_ES0 EQU 0
CYDEV_CHIP_REV_PSOC5LP_PRODUCTION EQU 0
CYDEV_CHIP_REV_TMA4_ES EQU 17
CYDEV_CHIP_REV_TMA4_ES2 EQU 33
CYDEV_CHIP_REV_TMA4_PRODUCTION EQU 17
CYDEV_CHIP_REVISION_3A_ES1 EQU 0
CYDEV_CHIP_REVISION_3A_ES2 EQU 1
CYDEV_CHIP_REVISION_3A_ES3 EQU 3
CYDEV_CHIP_REVISION_3A_PRODUCTION EQU 3
CYDEV_CHIP_REVISION_4A_ES0 EQU 17
CYDEV_CHIP_REVISION_4A_PRODUCTION EQU 17
CYDEV_CHIP_REVISION_4C_PRODUCTION EQU 0
CYDEV_CHIP_REVISION_4D_PRODUCTION EQU 0
CYDEV_CHIP_REVISION_4E_PRODUCTION EQU 0
CYDEV_CHIP_REVISION_4F_PRODUCTION EQU 0
CYDEV_CHIP_REVISION_4F_PRODUCTION_256DMA EQU 0
CYDEV_CHIP_REVISION_4F_PRODUCTION_256K EQU 0
CYDEV_CHIP_REVISION_4G_ES EQU 17
CYDEV_CHIP_REVISION_4G_ES2 EQU 33
CYDEV_CHIP_REVISION_4G_PRODUCTION EQU 17
CYDEV_CHIP_REVISION_4H_PRODUCTION EQU 0
CYDEV_CHIP_REVISION_4I_PRODUCTION EQU 0
CYDEV_CHIP_REVISION_4J_PRODUCTION EQU 0
CYDEV_CHIP_REVISION_4K_PRODUCTION EQU 0
CYDEV_CHIP_REVISION_4L_PRODUCTION EQU 0
CYDEV_CHIP_REVISION_4M_PRODUCTION EQU 0
CYDEV_CHIP_REVISION_4N_PRODUCTION EQU 0
CYDEV_CHIP_REVISION_4U_PRODUCTION EQU 0
CYDEV_CHIP_REVISION_5A_ES0 EQU 0
CYDEV_CHIP_REVISION_5A_ES1 EQU 1
CYDEV_CHIP_REVISION_5A_PRODUCTION EQU 1
CYDEV_CHIP_REVISION_5B_ES0 EQU 0
CYDEV_CHIP_REVISION_5B_PRODUCTION EQU 0
CYDEV_CHIP_REVISION_USED EQU CYDEV_CHIP_REVISION_5B_PRODUCTION
CYDEV_CHIP_REV_EXPECT EQU CYDEV_CHIP_REVISION_USED
CYDEV_CONFIG_FASTBOOT_ENABLED EQU 0
CYDEV_CONFIG_UNUSED_IO_AllowButWarn EQU 0
CYDEV_CONFIG_UNUSED_IO_AllowWithInfo EQU 1
CYDEV_CONFIG_UNUSED_IO_Disallowed EQU 2
CYDEV_CONFIG_UNUSED_IO EQU CYDEV_CONFIG_UNUSED_IO_Disallowed
CYDEV_CONFIGURATION_COMPRESSED EQU 0
CYDEV_CONFIGURATION_DMA EQU 1
CYDEV_CONFIGURATION_ECC EQU 1
CYDEV_CONFIGURATION_IMOENABLED EQU CYDEV_CONFIG_FASTBOOT_ENABLED
CYDEV_CONFIGURATION_MODE_COMPRESSED EQU 0
CYDEV_CONFIGURATION_MODE_DMA EQU 2
CYDEV_CONFIGURATION_MODE EQU CYDEV_CONFIGURATION_MODE_DMA
CYDEV_CONFIGURATION_MODE_UNCOMPRESSED EQU 1
CYDEV_DEBUG_ENABLE_MASK EQU 0x20
CYDEV_DEBUG_ENABLE_REGISTER EQU CYREG_MLOGIC_DEBUG
CYDEV_DEBUGGING_DPS_Disable EQU 3
CYDEV_DEBUGGING_DPS_JTAG_4 EQU 1
CYDEV_DEBUGGING_DPS_JTAG_5 EQU 0
CYDEV_DEBUGGING_DPS_SWD EQU 2
CYDEV_DEBUGGING_DPS_SWD_SWV EQU 6
CYDEV_DEBUGGING_DPS EQU CYDEV_DEBUGGING_DPS_SWD_SWV
CYDEV_DEBUGGING_ENABLE EQU 1
CYDEV_DEBUGGING_XRES EQU 0
CYDEV_DMA_CHANNELS_AVAILABLE EQU 24
CYDEV_ECC_ENABLE EQU 0
CYDEV_HEAP_SIZE EQU 0x80
CYDEV_INSTRUCT_CACHE_ENABLED EQU 1
CYDEV_INTR_RISING EQU 0x00000003
CYDEV_IS_EXPORTING_CODE EQU 0
CYDEV_IS_IMPORTING_CODE EQU 0
CYDEV_PROJ_TYPE EQU 0
CYDEV_PROJ_TYPE_BOOTLOADER EQU 1
CYDEV_PROJ_TYPE_LAUNCHER EQU 5
CYDEV_PROJ_TYPE_LOADABLE EQU 2
CYDEV_PROJ_TYPE_LOADABLEANDBOOTLOADER EQU 4
CYDEV_PROJ_TYPE_MULTIAPPBOOTLOADER EQU 3
CYDEV_PROJ_TYPE_STANDARD EQU 0
CYDEV_PROTECTION_ENABLE EQU 0
CYDEV_STACK_SIZE EQU 0x0800
CYDEV_USE_BUNDLED_CMSIS EQU 1
CYDEV_VARIABLE_VDDA EQU 0
CYDEV_VDDA_MV EQU 5000
CYDEV_VDDD_MV EQU 5000
CYDEV_VDDIO0_MV EQU 5000
CYDEV_VDDIO1_MV EQU 5000
CYDEV_VDDIO2_MV EQU 5000
CYDEV_VDDIO3_MV EQU 5000
CYDEV_VIO0_MV EQU 5000
CYDEV_VIO1_MV EQU 5000
CYDEV_VIO2_MV EQU 5000
CYDEV_VIO3_MV EQU 5000
CYIPBLOCK_ARM_CM3_VERSION EQU 0
CYIPBLOCK_P3_ANAIF_VERSION EQU 0
CYIPBLOCK_P3_CAN_VERSION EQU 0
CYIPBLOCK_P3_CAPSENSE_VERSION EQU 0
CYIPBLOCK_P3_COMP_VERSION EQU 0
CYIPBLOCK_P3_DECIMATOR_VERSION EQU 0
CYIPBLOCK_P3_DFB_VERSION EQU 0
CYIPBLOCK_P3_DMA_VERSION EQU 0
CYIPBLOCK_P3_DRQ_VERSION EQU 0
CYIPBLOCK_P3_DSM_VERSION EQU 0
CYIPBLOCK_P3_EMIF_VERSION EQU 0
CYIPBLOCK_P3_I2C_VERSION EQU 0
CYIPBLOCK_P3_LCD_VERSION EQU 0
CYIPBLOCK_P3_LPF_VERSION EQU 0
CYIPBLOCK_P3_OPAMP_VERSION EQU 0
CYIPBLOCK_P3_PM_VERSION EQU 0
CYIPBLOCK_P3_SCCT_VERSION EQU 0
CYIPBLOCK_P3_TIMER_VERSION EQU 0
CYIPBLOCK_P3_USB_VERSION EQU 0
CYIPBLOCK_P3_VIDAC_VERSION EQU 0
CYIPBLOCK_P3_VREF_VERSION EQU 0
CYIPBLOCK_S8_GPIO_VERSION EQU 0
CYIPBLOCK_S8_IRQ_VERSION EQU 0
CYIPBLOCK_S8_SAR_VERSION EQU 0
CYIPBLOCK_S8_SIO_VERSION EQU 0
CYIPBLOCK_S8_UDB_VERSION EQU 0
DMA_CHANNELS_USED__MASK0 EQU 0x00000000
CYDEV_BOOTLOADER_ENABLE EQU 0
    ENDIF
    END
